## conf/layer.conf
```bitbake
# We have a conf and classes directory, add to BBPATH
BBPATH .= ":${LAYERDIR}"

# We have a packages directory, add to BBFILES
BBFILES += "${LAYERDIR}/recipes-*/*/*.bb \
            ${LAYERDIR}/recipes-*/*/*.bbappend"

BBFILE_COLLECTIONS += "scalys-trustsom"
BBFILE_PATTERN_scalys-trustsom := "^${LAYERDIR}/"
BBFILE_PRIORITY_scalys-trustsom = "6"

LAYERSERIES_COMPAT_scalys-trustsom = "dunfell"
```

## conf/machine/grapeboard.conf
```bitbake
#@TYPE: Machine
#@NAME: Scalys Grapeboard
#@SOC: LSCH2
#@DESCRIPTION: Machine configuration for running LS1012A in 64-bit mode
#@MAINTAINER: Dmitry Lavnikevich <dmitry.lavnikevich@edality.by>

require conf/machine/include/qoriq-arm64.inc
require conf/machine/include/arm/arch-arm64.inc

SOC_FAMILY = "fsl-lsch2:ls1012a"

KERNEL_IMAGETYPE = "Image"
KERNEL_DEVICETREE ?= "freescale/grapeboard.dtb"
KERNEL_DEFCONFIG ?= "defconfig"

UBOOT_CONFIG ??= "sata pcie"
UBOOT_CONFIG[sata] = "grapeboard_sata_qspi_config,,u-boot-with-pbl.bin"
UBOOT_CONFIG[pcie] = "grapeboard_pcie_qspi_config,,u-boot-with-pbl.bin"
UBOOT_ENTRYPOINT = "0x80080000"

SERIAL_CONSOLES ?= "115200;ttyS0 115200;ttyAMA0"
SERIAL_CONSOLES_CHECK ?= "${SERIAL_CONSOLES}"

USE_VT = "0"

KERNEL_MODULE_AUTOLOAD += "rtl8723bu"
MACHINE_EXTRA_RRECOMMENDS += "kernel-module-8723bu kernel-firmware-rtl8723bu-nic kernel-firmware-rtl8723bu-bt"

MKUBIFS_ARGS = "--min-io-size 1 --leb-size 262016 --max-leb-cnt 245"
UBINIZE_ARGS = "--min-io-size 1 --peb-size 262144 --sub-page-size 1"
UBI_VOLNAME = "boot"

DISTRO_FEATURES_append = " systemd"
DISTRO_FEATURES_BACKFILL_CONSIDERED += "sysvinit"
VIRTUAL-RUNTIME_init_manager = "systemd"
VIRTUAL-RUNTIME_initscripts = "systemd-compat-units"

PREFERRED_PROVIDER_virtual/kernel = "linux-lsdk"
PREFERRED_PROVIDER_virtual/bootloader = "u-boot-lsdk"
```

## conf/machine/trustsom-tbdconnect.conf
```bitbake
#@TYPE: Machine
#@NAME: Scalys TrustSOM TbDConnect
#@SOC: LSCH3
#@DESCRIPTION: Machine configuration for running TrustSOM on Trustbox Diplomat Connect carrier in 64-bit mode
#@MAINTAINER: <opensource@scalys.com>

require conf/machine/include/qoriq-arm64.inc
require conf/machine/include/arm/arch-arm64.inc

MACHINE_FEATURES += "optee"

MACHINEOVERRIDES =. "fsl-lsch3:ls1028a:"

KERNEL_CLASSES  = " kernel-fitimage "
KERNEL_IMAGETYPES = "fitImage Image.gz"

UBOOT_DTB_LOADADDRESS = "0x90000000"
UBOOT_ENTRYPOINT = "0x80080000"

UBOOT_CONFIG ??= "tfa-secure-boot tfa"
UBOOT_CONFIG[tfa-secure-boot] = "trustsomtbdconnect_tfa_SECURE_BOOT_defconfig,,u-boot-dtb.bin"
UBOOT_CONFIG[tfa] = "trustsomtbdconnect_tfa_defconfig,,u-boot-dtb.bin"

KERNEL_DEVICETREE ?= "freescale/trustsom-tbdconnect.dtb"

KERNEL_DEFCONFIG ?= "defconfig"

SERIAL_CONSOLES ?= "115200;ttyS0 115200;ttyS1 115200;ttyAMA0"
SERIAL_CONSOLES_CHECK ?= "${SERIAL_CONSOLES}"

RCWSD ?= "N_NNNN_0x0000/rcw_1500_sdboot"
RCWXSPI ?= ""
RCWEMMC ?= ""

EXTRA_IMAGEDEPENDS += "rcw atf dp-firmware-cadence"
USE_VT = "0"
```

## conf/machine/trustsom.conf
```bitbake
#@TYPE: Machine
#@NAME: Scalys TrustSOM
#@SOC: LSCH3
#@DESCRIPTION: Machine configuration for trustsom. Intended as a base configuration extended by carrier and use case specific implemenations 
#@MAINTAINER: <opensource@scalys.com>

#require conf/machine/include/qoriq-arm64.inc
require conf/machine/include/arm/arch-arm64.inc

DISTRO = "poky"
DISTRO_FEATURES += " systemd"
MACHINE_FEATURES += "optee tpm2"

MACHINEOVERRIDES =. "fsl-lsch3:ls1028a:"

KERNEL_CLASSES  = " kernel-fitimage "
KERNEL_IMAGETYPES = "fitImage Image.gz"
#KERNEL_DEVICETREE = "freescale/trustsom.dtb"

UBOOT_DTB_LOADADDRESS = "0x90000000"
UBOOT_ENTRYPOINT = "0x80080000"

UBOOT_CONFIG ??= "tfa-secure-boot tfa"
UBOOT_CONFIG[tfa-secure-boot] = "trustsom_tfa_SECURE_BOOT_defconfig,,u-boot-dtb.bin"
UBOOT_CONFIG[tfa] = "trustsom_tfa_defconfig,,u-boot-dtb.bin"

PREFERRED_PROVIDER_virtual/kernel ?= "linux-trustsom"
#PREFERRED_PROVIDER_virtual/kernel ?= "linux-yocto"
KERNEL_IMAGETYPE = "Image"
#KERNEL_DEVICETREE ?= "freescale/trustsom-tbdconnect.dtb"
#KERNEL_DEFCONFIG ?= "defconfig"

SERIAL_CONSOLES ?= "115200;ttyS0 115200;ttyS1 115200;ttyAMA0"
SERIAL_CONSOLES_CHECK ?= "${SERIAL_CONSOLES}"

RCWSD ?= "N_SQPP_0x85BB/rcw_1500_sdboot"
RCWXSPI ?= ""
RCWEMMC ?= "N_SQPP_0x85BB/rcw_1500_sdboot"

#EXTRA_IMAGEDEPENDS += "rcw atf"

# We default to not use Virtual Terminals
USE_VT = "0"
```

## recipes-images/images/scalys-image-kernelitb/kernel-all.its
```
/*
 * Copyright 2017 NXP
 *           2021 Scalys
 *
 */


/dts-v1/;

/ {
	description = "arm64 kernel and FDT blob";
	#address-cells = <1>;

	images {
		kernel {
			description = "ARM64 Kernel";
			data = /incbin/("kernel-image.gz");
			type = "kernel";
			arch = "arm64";
			os = "linux";
			compression = "gzip";
			load = <0x81080000>;
			entry = <0x81080000>;
			hash@1 {
				algo = "crc32";
			};
		};

		fdt-dtb {
			description = "dtb";
			data = /incbin/("freescale.dtb");
			type = "flat_dt";
			arch = "arm64";
			os = "linux";
			compression = "none";
			load = <0x90000000>;
			hash@1 {
				algo = "crc32";
			};
		};
	};

	configurations {
		trustsom-tbdconnect {
			description = "config for trustsom tbdconnect";
			kernel = "kernel";
			fdt = "fdt-dtb";
		};
	};
};
```
